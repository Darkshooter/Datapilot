VERSION "HIPBNYYYYYYYYYYYYYYYYYYYYYYYYYYYNNNNNNNNNN/4/%%%/4/'%**4NNN///"

NS_ :

BS_:

BU_: Vector__XXX

BO_ 2167208448 Acceleration_x_longitudinal: 8 Vector__XXX
 SG_ Acceleration_x_longitudinal : 32|32@1- (1,0) [0|255] "m/s2" Vector__XXX

BO_ 2167273984 Accelerationiny_lateral: 8 Vector__XXX
 SG_ Acceleration_y_lateral : 32|32@1- (1,0) [0|255] "m/s2" Vector__XXX

BO_ 2167339520 Accelerationinz_normal: 8 Vector__XXX
 SG_ Acceleration_z_normal : 32|32@1- (1,0) [0|255] "m/s2" Vector__XXX

BO_ 2168191744 Indicatedairspeed: 8 Vector__XXX
 SG_ Indicated_airspeed : 32|32@1- (1,0) [0|255] "m/s" Vector__XXX

BO_ 2168847104 Differentialpressure: 8 Vector__XXX
 SG_ Differentialpressure : 32|32@1- (1,0) [0|255] "hPa" Vector__XXX

BO_ 2180316672 EngineRPM: 8 Vector__XXX
 SG_ Engine_Speed : 32|32@1- (1,0) [0|255] " RPM" Vector__XXX

BO_ 2181889536 Enginefuelflowrate: 8 Vector__XXX
 SG_ Engine_fuel_flowrate : 32|32@1- (1,0) [0|255] "l/h" Vector__XXX

BO_ 2182151680 Manifoldpressure1: 8 Vector__XXX
 SG_ Manifold_pressure : 32|32@1- (1,0) [0|255] "bar" Vector__XXX

BO_ 2182413824 Engineoilpressure1: 8 Vector__XXX
 SG_ Engine_oil_pressure : 32|32@1- (1,0) [0|255] "bar" Vector__XXX

BO_ 2182675968 Engine_oil_temperature1: 8 Vector__XXX
 SG_ Engine_oil_temperature : 32|32@1- (1,0) [0|255] "C" Vector__XXX

BO_ 2191326720 Fuellevel1: 8 Vector__XXX
 SG_ Fuel_level : 32|32@1- (1,0) [0|255] "liters" Vector__XXX

BO_ 2192375296 Fuelsystempressure1: 8 Vector__XXX
 SG_ Fuel_pressure : 32|32@1- (1,0) [0|255] "bar" Vector__XXX

BO_ 2207841792 Voltage_DC_1: 8 Vector__XXX
 SG_ Bat_Voltage_DC : 32|32@1- (1,0) [0|255] "V" Vector__XXX

BO_ 2245852672 CHT: 8 Vector__XXX
 SG_ SG_CHT_Index M : 16|8@1+ (1,0) [0|1] "" Vector__XXX
 SG_ CT_1 m0 : 32|32@1- (1,0) [-20|300] "degC" Vector__XXX
 SG_ CT_2 m1 : 32|32@1- (1,0) [-20|300] "degC" Vector__XXX

BO_ 2245918208 EGT: 8 Vector__XXX
 SG_ SG_EGT_Index M : 16|8@1+ (1,0) [0|1] "" Vector__XXX
 SG_ EGT_1 m0 : 32|32@1- (1,0) [-20|1500] "degC" Vector__XXX
 SG_ EGT_2 m1 : 32|32@1- (1,0) [-20|1500] "degC" Vector__XXX

BO_ 2247294464 Flighttime: 8 Vector__XXX
 SG_ Flight_time : 0|32@1+ (1,0) [0|255] "" Vector__XXX

BO_ 2168126720 Verticalspeed: 8 Vector__XXX
 SG_ Vertical_speed : 32|32@1- (1,0) [0|255] "m/s" Vector__XXX

BO_ 2168454400 Barometriccorrection_QNH: 8 Vector__XXX
 SG_ Barometric_correction_QNH : 32|32@1- (1,0) [0|255] "hPa" Vector__XXX

BO_ 2168519936 Barocorrectedaltitude: 8 Vector__XXX
 SG_ Baro_corrected_altitude : 32|32@1- (1,0) [0|255] "m" Vector__XXX

BO_ 2168651008 Standard_altitude: 8 Vector__XXX
 SG_ Standard_altitude : 32|32@1- (1,0) [0|255] "m" Vector__XXX

BO_ 2168913152 Static_pressure: 8 Vector__XXX
 SG_ Static_pressure : 32|32@1- (1,0) [0|255] "hPa" Vector__XXX

BO_ 2246507776 Enginetotaltime: 8 Vector__XXX
 SG_ Engine_totaltime : 32|32@1- (1,0) [0|255] "h" Vector__XXX

BA_DEF_ SG_  "GenSigSendType" ENUM  "Cyclic","OnWrite","OnWriteWithRepetition","OnChange","OnChangeWithRepetition","IfActive","IfActiveWithRepetition","NoSigSendType";
BA_DEF_ BO_  "GenMsgSendType" ENUM  "Cyclic","not_used","not_used","not_used","not_used","Cyclic","not_used","IfActive","NoMsgSendType";
BA_DEF_  "BusType" STRING  ;
BA_DEF_  "ProtocolType" STRING  ;
BA_DEF_DEF_  "GenSigSendType" "Cyclic";
BA_DEF_DEF_  "GenMsgSendType" "NoMsgSendType";
BA_DEF_DEF_  "BusType" "CAN";
BA_DEF_DEF_  "ProtocolType" "KanCan";
SIG_VALTYPE_ 2167208448 Acceleration_x_longitudinal : 1;
SIG_VALTYPE_ 2167273984 Acceleration_y_lateral : 1;
SIG_VALTYPE_ 2167339520 Acceleration_z_normal : 1;
SIG_VALTYPE_ 2168191744 Indicated_airspeed : 1;
SIG_VALTYPE_ 2168847104 Differentialpressure : 1;
SIG_VALTYPE_ 2180316672 Engine_Speed : 1;
SIG_VALTYPE_ 2181889536 Engine_fuel_flowrate : 1;
SIG_VALTYPE_ 2182151680 Manifold_pressure : 1;
SIG_VALTYPE_ 2182413824 Engine_oil_pressure : 1;
SIG_VALTYPE_ 2182675968 Engine_oil_temperature : 1;
SIG_VALTYPE_ 2191326720 Fuel_level : 1;
SIG_VALTYPE_ 2192375296 Fuel_pressure : 1;
SIG_VALTYPE_ 2207841792 Bat_Voltage_DC : 1;
SIG_VALTYPE_ 2245852672 CT_1 : 1;
SIG_VALTYPE_ 2245852672 CT_2 : 1;
SIG_VALTYPE_ 2245918208 EGT_1 : 1;
SIG_VALTYPE_ 2245918208 EGT_2 : 1;
SIG_VALTYPE_ 2168126720 Vertical_speed : 1;
SIG_VALTYPE_ 2168454400 Barometric_correction_QNH : 1;
SIG_VALTYPE_ 2168519936 Baro_corrected_altitude : 1;
SIG_VALTYPE_ 2168651008 Standard_altitude : 1;
SIG_VALTYPE_ 2168913152 Static_pressure : 1;
SIG_VALTYPE_ 2246507776 Engine_totaltime : 1;
